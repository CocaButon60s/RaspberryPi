## layers/meta-customize/conf/layer.conf
```bitbake
# We have a conf and classes directory, add to BBPATH
BBPATH .= ":${LAYERDIR}"

# We have recipes-* directories, add to BBFILES
BBFILES += "${LAYERDIR}/recipes-*/*/*.bb \
            ${LAYERDIR}/recipes-*/*/*.bbappend"

BBFILE_COLLECTIONS += "meta-customize"
BBFILE_PATTERN_meta-customize = "^${LAYERDIR}/"
BBFILE_PRIORITY_meta-customize = "6"

LAYERDEPENDS_meta-customize = "core"
LAYERSERIES_COMPAT_meta-customize = "walnascar"
```
